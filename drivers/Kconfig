## drivers/motor_driver/Kconfig
```kconfig
menuconfig MOTOR_DRIVER
    bool "Motor driver support"
    help
      Enable support for motor drivers

if MOTOR_DRIVER

config MOTOR_DRIVER_LOG_LEVEL
    int "Motor driver log level"
    depends on LOG
    default 3
    help
      Set log level for motor drivers.

config MOTOR_DRIVER_INIT_PRIORITY
    int "TB6612 driver initialization priority"
    default 80
    range 0 99
    help
      Driver initialization priority for TB6612 drivers.
	  Must be higher than PWM and GPIO controllers priorities.

module = MOTOR
module-str = motor
source "subsys/logging/Kconfig.template.log_config"

rsource "tb6612/Kconfig.tb6612"

endif
```

## drivers/motor_driver/tb6612/Kconfig.tb6612
```kconfig
# Copyright (c) 2025, Cody Gu <gujiaqi@iscas.ac.cn>
# SPDX-License-Identifier: Apache-2.0
#

DT_COMPAT_TB6612FNG := toshiba,tb6612fng

config MOTOR_DRIVER_TB6612
	bool "TB6612 Dual H-bridge Motor driver"
	default $(dt_compat_enabled,$(DT_COMPAT_TB6612FNG))
	select PINCTRL
	select PWM
	help
	  TB6612 Dual H-bridge Motor driver.
```

## drivers/sensor/encoder/Kconfig
```kconfig
# Copyright (c) 2022, Valerio Setti <vsetti@baylibre.com>
# SPDX-License-Identifier: Apache-2.0
#

config ENCODER_STM32
	bool "STM32 QDEC driver(Custom)"
	default y
	depends on DT_HAS_ST_STM32_ENCODER_ENABLED
	select PINCTRL
	select USE_STM32_LL_TIM
	help
	  STM32 family Quadrature Decoder driver(Custom).
```

## drivers/zephyr/dts/bindings/motor_driver/toshiba,tb6612fng.yaml
```yaml
# Copyright (c) 2025, Cody Gu <gujiaqi@iscas.ac.cn>
# SPDX-License-Identifier: Apache-2.0

description: |
  Toshiba TB6612FNG dual H-bridge motor driver controller.
  This driver provides PWM control for two DC motors with direction control.

  example:
  - |
    #include <dt-bindings/pwm/pwm.h>
    #include <dt-bindings/gpio/gpio.h>

    motor-controller {
        compatible = "toshiba,tb6612fng";
        
        /* PWM */
        pwms = <&pwm1 0 PWM_POLARITY_NORMAL>,
               <&pwm1 1 PWM_POLARITY_NORMAL>;
        pwm-period = <20000>;

        /* GPIO */
        ain1-gpios = <&gpiod 10 GPIO_ACTIVE_HIGH>;
        ain2-gpios = <&gpiod 11 GPIO_ACTIVE_HIGH>;
        bin1-gpios = <&gpiod 12 GPIO_ACTIVE_HIGH>;
        bin2-gpios = <&gpiod 13 GPIO_ACTIVE_HIGH>;
        stby-gpios = <&gpiod 14 GPIO_ACTIVE_HIGH>;
    };

compatible: "toshiba,tb6612fng"

include:
  - name: base.yaml
  
properties:
  pwms:
    type: phandle-array
    required: true
    description: |
      PWM specifiers for both motor channels (A & B).
      Must contain exactly two PWM entries:
        - Index 0: Channel A PWM
        - Index 1: Channel B PWM

  ain1-gpios:
    type: phandle-array
    required: true
    description: GPIO for Channel A direction control 1

  ain2-gpios:
    type: phandle-array
    required: true
    description: GPIO for Channel A direction control 2

  bin1-gpios:
    type: phandle-array
    required: true
    description: GPIO for Channel B direction control 1

  bin2-gpios:
    type: phandle-array
    required: true
    description: GPIO for Channel B direction control 2

  stby-gpios:
    type: phandle-array
    required: true
    description: Standby control GPIO (active high)

child-binding:
  description: Motor channel nodes (optional)
  properties:
    channel:
      type: int
      required: true
      description: |
        Motor channel identifier:
        - 0: Channel A
        - 1: Channel B
```

## modules/libmicroxrcedds/Kconfig
```kconfig
# SPDX-License-Identifier: Apache-2.0

config MICROXRCEDDSCLIENT
    bool "Micro XRCE-DDS Client"
    help
      Enable the Micro XRCE-DDS Client library support.
      This library provides DDS-XRCE protocol implementation
      for microcontroller environments.

if MICROXRCEDDSCLIENT

config MICROXRCEDDSCLIENT_CUSTOM_TRANSPORT
    bool "Use custom transport implementation"
    default y
    help
      Enable custom transport implementation instead of built-in
      UDP, TCP or serial transports.

config MICROXRCEDDSCLIENT_TRANSPORT_MTU
    int "Transport MTU size"
    default 512
    help
      Maximum transmission unit size for the transport layer.

endif # MICROXRCEDDSCLIENT
```
